## boards/shields/Kconfig.defconfig
```kconfig
if SHIELD_SHORKY21
config ZMB_SHORKY21
	default "Shorky21"
endif

if ZMK_BACKLIGHT

config PWM
    default y

config LED_PWM
    default y

endif # ZMK_BACKLIGHT
```
